## sdkconfig.defaults
```kconfig
# Enable TinyUSB
CONFIG_TINYUSB=y
CONFIG_TINYUSB_CDC_ENABLED=y
CONFIG_TINYUSB_CDC_COUNT=1

# Disable USB Serial JTAG (conflicts with TinyUSB)
CONFIG_ESP_CONSOLE_USB_SERIAL_JTAG=n
CONFIG_ESP_CONSOLE_SECONDARY_NONE=y

# USB settings
CONFIG_TINYUSB_DESC_USE_ESPRESSIF_VID=y
CONFIG_TINYUSB_DESC_PRODUCT_STRING="ESP32 SLCAN Adapter"
CONFIG_TINYUSB_DESC_MANUFACTURER_STRING="Espressif"
CONFIG_TINYUSB_DESC_SERIAL_STRING="123456"

# CAN/TWAI
CONFIG_TWAI_ISR_IN_IRAM=y
```
